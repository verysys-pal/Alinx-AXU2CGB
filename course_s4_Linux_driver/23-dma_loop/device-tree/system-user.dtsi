/include/ "system-conf.dtsi"
/ {
	dmatest_0: dmatest@0 {
		compatible ="xlnx,axi-dma-test-1.00.a";
		dmas = <&axi_dma_0 0
			&axi_dma_0 1>;
		dma-names = "axidma0", "axidma1";
	};
};

/* SD */
&sdhci1 {
	disable-wp;
	no-1-8-v;
};

/* USB  */
&dwc3_0 {
	status = "okay";
	dr_mode = "host";
};







