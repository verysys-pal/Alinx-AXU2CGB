/include/ "system-conf.dtsi"
/ {
};

/* SD */
&sdhci1 {
	disable-wp;
	no-1-8-v;
};

/* USB */
&dwc3_0 {
	status = "okay";
	dr_mode = "host";
};

&ad9767_send_0 {
	compatible = "alinx,axi-adc-dma";
	dmas = <&axi_dma_0 0>;
	dma-names = "axidma0";
};

&ad9767_send_1 {
	compatible = "alinx,axi-adc-dma";
	dmas = <&axi_dma_1 0>;
	dma-names = "axidma0";
};

