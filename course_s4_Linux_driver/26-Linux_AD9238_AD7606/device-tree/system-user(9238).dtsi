/include/ "system-conf.dtsi"
/ {
};

/* SD */
&sdhci1 {
	disable-wp;
	no-1-8-v;
};

/* USB */
&dwc3_0 {
	status = "okay";
	dr_mode = "host";
};

&ad9238_sample_0 {
	compatible = "alinx,axi-adc-dma";
	dmas = <&axi_dma_0 1>;
	dma-names = "axidma1";
};

&ad9238_sample_1 {
	compatible = "alinx,axi-adc-dma";
	dmas = <&axi_dma_1 1>;
	dma-names = "axidma1";
};


